## boards/nordic/nrf54h20dk/Kconfig.defconfig
```kconfig
# Copyright (c) 2024 Nordic Semiconductor ASA
# SPDX-License-Identifier: Apache-2.0

if BOARD_NRF54H20DK_NRF54H20_CPUAPP

config ROM_START_OFFSET
	default 0x800 if BOOTLOADER_MCUBOOT

config BT_HCI_IPC
	default y if BT

config MAX_THREAD_BYTES
	default 3 if USERSPACE

endif # BOARD_NRF54H20DK_NRF54H20_CPUAPP

if BOARD_NRF54H20DK_NRF54H20_CPURAD

config MAX_THREAD_BYTES
	default 3 if USERSPACE

endif # BOARD_NRF54H20DK_NRF54H20_CPURAD
```

## samples/hello_world/sample.yaml
```yaml
sample:
  description: Hello World sample, the simplest Zephyr
    application
  name: hello world
common:
  min_ram: 2
  min_flash: 16
  tags: introduction
  integration_platforms:
    - native_sim
  harness: console
  harness_config:
    type: one_line
    regex:
      - "Hello World! (.*)"
tests:
  sample.basic.helloworld:
    tags: introduction

  sample.basic.mcuboot.single_app:
    extra_args:
      - FILE_SUFFIX="single_app"
    platform_allow:
      - nrf54l15dk/nrf54l15/cpuapp
    integration_platforms:
      - nrf54l15dk/nrf54l15/cpuapp

  sample.basic.mcuboot.fw_loader:
    extra_args:
      - FILE_SUFFIX="fw_loader"
    platform_allow:
      - nrf54l15dk/nrf54l15/cpuapp
    integration_platforms:
      - nrf54l15dk/nrf54l15/cpuapp
```
